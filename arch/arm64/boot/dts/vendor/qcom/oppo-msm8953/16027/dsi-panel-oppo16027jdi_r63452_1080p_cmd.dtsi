/* Copyright (c) 2015-2016, The Linux Foundation. All rights reserved.
 *
 * This program is free software; you can redistribute it and/or modify
 * it under the terms of the GNU General Public License version 2 and
 * only version 2 as published by the Free Software Foundation.
 *
 * This program is distributed in the hope that it will be useful,
 * but WITHOUT ANY WARRANTY; without even the implied warranty of
 * MERCHANTABILITY or FITNESS FOR A PARTICULAR PURPOSE.  See the
 * GNU General Public License for more details.
 */

/*---------------------------------------------------------------------------
 * This file is autogenerated file using gcdb parser. Please do not edit it.
 * Update input XML file to add a new entry or update variable in this file
 * VERSION = "1.0"
 *---------------------------------------------------------------------------*/
&mdss_mdp {
        dsi_oppo16027jdi_r63452_1080p_cmd: qcom,mdss_dsi_oppo16027jdi_r63452_1080p_cmd {
                qcom,cont-splash-enabled;
                qcom,mdss-dsi-panel-name = "oppo16027jdi r63452 1080p cmd mode dsi panel";
                qcom,mdss-dsi-panel-manufacture = "JDI";
                qcom,mdss-dsi-panel-version = "R63452";
                qcom,mdss-dsi-panel-controller = <&mdss_dsi0>;
                qcom,mdss-dsi-panel-type = "dsi_cmd_mode";
                qcom,mdss-dsi-panel-destination = "display_1";
                qcom,mdss-dsi-panel-framerate = <60>;
                qcom,mdss-dsi-virtual-channel-id = <0>;
                qcom,mdss-dsi-stream = <0>;
                qcom,mdss-dsi-panel-width = <1080>;
                qcom,mdss-dsi-panel-height = <1920>;
                qcom,mdss-dsi-h-front-porch = <100>;
                qcom,mdss-dsi-h-back-porch = <94>;
                qcom,mdss-dsi-h-pulse-width = <2>;
                qcom,mdss-dsi-h-sync-skew = <0>;
                qcom,mdss-dsi-v-back-porch = <20>;
                qcom,mdss-dsi-v-front-porch = <8>;
                qcom,mdss-dsi-v-pulse-width = <4>;
                qcom,mdss-dsi-h-left-border = <0>;
                qcom,mdss-dsi-h-right-border = <0>;
                qcom,mdss-dsi-v-top-border = <0>;
                qcom,mdss-dsi-v-bottom-border = <0>;
                qcom,mdss-dsi-bpp = <24>;
                qcom,mdss-dsi-color-order = "rgb_swap_rgb";
                qcom,mdss-dsi-underflow-color = <0xff>;
                qcom,mdss-dsi-border-color = <0>;
                qcom,mdss-dsi-on-command = [39 01 00 00 00 00 02 35 00
                    39 01 00 00 00 00 02 B0 00
                    39 01 00 00 00 00 04 E9 40 00 00
                    39 01 00 00 00 00 02 D6 01
                    39 01 00 00 00 00 02 51 FF
                    39 01 00 00 00 00 02 53 24
                    39 01 00 00 00 00 02 55 02
                    39 01 00 00 00 00 02 5E 00
                    39 01 00 00 00 00 08 B9 8F 4D 13 20 02 30 30
                    39 01 00 00 00 00 1A CE 11 40 49 53 59 5E 63 68 6E 74 7E 8A 98 A8 BB D0 FF 04 00 04 04 42 00 69 5A
                    39 01 00 00 78 00 02 11 00
                    39 01 00 00 14 00 02 29 00];
                qcom,mdss-dsi-off-command = [05 01 00 00 14 00 02 28 00
                    05 01 00 00 78 00 02 10 00];
                qcom,mdss-dsi-on-command-state = "dsi_lp_mode";
                qcom,mdss-dsi-off-command-state = "dsi_hs_mode";
                qcom,mdss-dsi-h-sync-pulse = <1>;
                qcom,mdss-dsi-traffic-mode = "burst_mode";
                qcom,mdss-dsi-lane-map = "lane_map_0123";
                qcom,mdss-dsi-bllp-eof-power-mode;
                qcom,mdss-dsi-bllp-power-mode;
                qcom,mdss-dsi-lane-0-state;
                qcom,mdss-dsi-lane-1-state;
                qcom,mdss-dsi-lane-2-state;
                qcom,mdss-dsi-lane-3-state;
                qcom,mdss-dsi-panel-timings = [E6 38 26 00 68 6C 2A 3C 2C 03 04 00];
                qcom,mdss-dsi-te-pin-select = <1>;
                qcom,mdss-dsi-wr-mem-start = <0x2c>;
                qcom,mdss-dsi-wr-mem-continue = <0x3c>;
                qcom,mdss-dsi-te-dcs-command = <1>;
                qcom,mdss-dsi-te-check-enable;
                qcom,mdss-dsi-te-using-te-pin;
                qcom,mdss-dsi-t-clk-post = <0x02>;
                qcom,mdss-dsi-t-clk-pre = <0x2B>;
                qcom,mdss-dsi-bl-min-level = <1>;
                qcom,mdss-dsi-bl-max-level = <255>;
                qcom,mdss-brightness-max-level = <255>;
                qcom,mdss-dsi-dma-trigger = "trigger_sw";
                qcom,mdss-dsi-mdp-trigger = "trigger_sw";
                qcom,mdss-dsi-bl-pmic-control-type = "bl_ctrl_wled";
                qcom,mdss-dsi-lp11-init;
                qcom,mdss-dsi-init-delay-us = <5000>;
                qcom,mdss-dsi-reset-sequence = <1 15>, <0 2>, <1 15>;
                qcom,mdss-dsi-rx-eot-ignore;
                qcom,mdss-dsi-tx-eot-append;
                /*
                 * 关闭 ESD 检查（原来是 qcom,esd-check-enabled;）。
                 *
                 * 真机日志（g9f0fe3d）17.37s 的连锁：
                 *   mdss_dsi_cmp_panel_reg_v2: [0][0] return:0x10 status:0x38
                 *   mdss_dsi_gen_read_status: Read value bad. Error_cnt = 1
                 *   mdss_fb_report_panel_dead: Panel gone bad (PANEL_ALIVE=0)
                 *   __mdss_fb_sync_buf_done_callback: mdp-fence: frame timeout
                 *   mdss_dsi_cmd_mdp_busy: timeout error
                 *   mdss_mdp_cmd_wait4pingpong: timed out ctl=0 koff_cnt=1
                 *
                 * 面板 0x0A 状态寄存器读回 0x10，DTS 期望 0x38 -> 判 panel dead。
                 * 该链最终执行 mdss_mdp_display_wait4pingpong() 的恢复分支：
                 *   mdss_mdp_ctl_reset(ctl, true);    // 写 CTL_SW_RESET
                 *   MDSS_EVENT_DSI_RESET_WRITE_PTR    // DSI 写指针归零
                 * 整个 MDP 控制器被软复位、写指针归零，画面反复重新开始 ——
                 * 这就是「桌面图标不正常、且跟着图标动」的直接成因。
                 *
                 * 已逐行对比 4.9 的 DSI 读路径（cmds_rx / cmd_dma_rx /
                 * short_response / cmdlist_commit 的 LP-HS 切换 / pingpong
                 * 回调 / tearcheck_cfg / hw_vsync_mode 判定），4.19 与 4.9
                 * 完全一致，说明 0x10 不是移植引入的解析 bug；本机在解锁 +
                 * 第三方 rootfs 下 ESD 读状态本就拿不到厂家可信值。
                 *
                 * 关掉后 panel_dead -> MDP 软复位 -> 画面跳动 不再触发。
                 * 代价：真被静电打到花屏不会自动恢复，需息屏再亮屏。
                 */
                /* qcom,esd-check-enabled;  —— 已关闭，原因见上 */
                qcom,mdss-dsi-panel-status-read-length = <1>;
                qcom,mdss-dsi-panel-status-check-mode="reg_read";
                qcom,mdss-dsi-panel-status-command = [06 01 00 01 05 00 02 0A 08];
                qcom,mdss-dsi-panel-status-command-state = "dsi_lp_mode";
                qcom,mdss-dsi-panel-status-value = <0x38>;
                qcom,mdss-pan-physical-width-dimension = <68>;
                qcom,mdss-pan-physical-height-dimension = <122>;
                qcom,mdss-mdp-transfer-time-us = <12000>;

                cm,mdss-livedisplay-cabc-ui-value = <0x01>;
                cm,mdss-livedisplay-cabc-image-value = <0x02>;
                cm,mdss-livedisplay-cabc-video-value = <0x03>;
                cm,mdss-livedisplay-cabc-cmd = [15 00 00 00 01 00 02 55 00];
                cm,mdss-livedisplay-post-cmd = [15 01 00 00 01 00 02 53 2C];
        };
};
